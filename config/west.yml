## config/west.yml
```yaml
manifest:
  remotes:
    - name: zmkfirmware
      url-base: https://github.com/zmkfirmware
    - name: iwk7273
      url-base: https://github.com/iwk7273
    - name: r-keys-kbd
      url-base: https://github.com/r-Keys-kbd
  projects:
    - name: zmk
      remote: zmkfirmware
      # revision: main
      revision: v0.3 
      import: app/west.yml
    - name: zmk-pmw3610-driver
      remote: r-keys-kbd
      revision: main
      path: modules/zmk-pmw3610-driver
    - name: zmk-feature-sensor_rotation
      remote: iwk7273
      revision: main
    - name: zmk-feature-xy_clipper
      remote: iwk7273
      revision: main
    - name: zmk-feature-scaling
      remote: iwk7273
      revision: main
    - name: zmk-smart-toggle
      remote: iwk7273
      revision: main
    - name: zmk-feature-meteorite-config
      remote: iwk7273
      revision: main
  self:
    path: config
```
